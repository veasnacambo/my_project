## CMakeLists.txt
```
# SPDX-License-Identifier: Apache-2.0

cmake_minimum_required(VERSION 3.20.0)
macro(app_set_runner_args)
  board_runner_args(dfu-util "--dfuse-modifiers=force:mass-erase")
  board_runner_args(pyocd "--erase")
  board_runner_args(nrfjprog "--erase")
endmacro()
#add_subdirectory(EXTERNAL/Zephyr EXCLUDE_FROM_ALL)
 
find_package(Zephyr REQUIRED HINTS $ENV{ZEPHYR_BASE})
project(my_project) #Project directory


FILE(GLOB app_sources src/*.c)
target_sources(app PRIVATE ${app_sources})
target_include_directories(app PRIVATE 
${ZEPHYR_BASE}/subsys/fs/nvs,
${ZEPHYR_BASE}/include/zephyr/portability)
```

## prj.conf
```kconfig
# prj.conf
CONFIG_LOG=y
CONFIG_SPI=y
CONFIG_GPIO=y
CONFIG_LORA=y
CONFIG_PRINTK=y

CONFIG_FLASH=y
CONFIG_FLASH_PAGE_LAYOUT=y

CONFIG_NVS=y
CONFIG_LOG_MODE_IMMEDIATE=y
CONFIG_NVS_LOG_LEVEL_DBG=y
CONFIG_MPU_ALLOW_FLASH_WRITE=y



CONFIG_ASSERT=y
CONFIG_ASSERT_LEVEL=2
CONFIG_CMSIS_RTOS_V2=y


# CONFIG_NUM_PREEMPT_PRIORITIES=56
# CONFIG_HEAP_MEM_POOL_SIZE=256
# CONFIG_THREAD_NAME=y
# CONFIG_THREAD_STACK_INFO=y
# CONFIG_THREAD_MONITOR=y
# CONFIG_INIT_STACKS=y
# CONFIG_POLL=y
# CONFIG_SCHED_SCALABLE=y
# The Zephyr CMSIS v2 emulation assumes that ticks are ms, currently
# CONFIG_SYS_CLOCK_TICKS_PER_SEC=1000
# CONFIG_COMMON_LIBC_MALLOC_ARENA_SIZE=0
```

## src/main.c
```c
#include "mesh.h"
#include "que_packet_handle.h"
#include "neighbor_table.h"
usr_data_info_t UserDataC  = {0};
int main(){

    // initialize nvs-storage
    nvs_memo_init();
    // initialize mesh-network.
    lora_mesh_init();
    neib_to_user(&gg,UserDataC.data);
    UserDataC.usr_req_id = user_check_deviceInfo;

    while (1)
    {
        mesh_handle(&UserDataC);  
    }   

    return 0;
}
```

## src/mesh.c
```c
#include <zephyr/device.h>
#include <zephyr/drivers/lora.h>
#include <zephyr/sys/util.h>
#include <zephyr/kernel.h>
#include <errno.h>
#include <stdio.h>
#include <stdlib.h>
#include <stdint.h>
#include <zephyr/types.h>
#include <cmsis_os2.h>
#include <string.h>
#include "mesh.h"
#include "que_packet_handle.h"
#include "neighbor_table.h"
#include "read.h"
#define LOG_LEVEL CONFIG_LOG_DEFAULT_LEVEL
#include <zephyr/logging/log.h>
LOG_MODULE_REGISTER(MESH_LORA);
#include <zephyr/logging/log.h>

uint8_t ack_stae ;
uint16_t k;
NeighborInfo_t my_device_info = {0};
NeighborTableInfo_t NTable ={0};

GroupInfo_t GroupChatData;

// stror group to delect in temporary
NeighborInfo_t deldata;
uint16_t data_id[255];
int  num;
uint8_t retry;
uint8_t recheck ;
uint16_t previous_id;
uint8_t lora_data[300];
que_packet_config resp_data;
uint8_t dsend[255];

que_packet_config ack_data ={0};
que_packet_config data_recv ={0};
que_packet_config previosu_data_recv;
uint16_t msg_id;
const struct device *lora_dev = DEVICE_DT_GET(DT_ALIAS(lora0));
struct lora_modem_config config;
int ret;
int16_t rssi;
uint8_t snr;
volatile bool state;
uint8_t user_req_response_buffer[248];
uint8_t send_resp_buf[256];
que_packet_config resp_buffer = {0};


int lora_mesh_init(void)
{
    if (!device_is_ready(lora_dev)) {
        LOG_ERR("LoRa device not ready\n");
        return 0;
    }
    config.frequency = 915000000;
    config.bandwidth = BW_125_KHZ;  // Adjust bandwidth as needed
    config.datarate = SF_9;           // Adjust datarec rate as needed
    config.preamble_len = 8;
    config.coding_rate = CR_4_5;
    config.iq_inverted = false;
    config.public_network = false;
    config.tx_power = 20;              // Adjust transmit power as needed
    config.tx = true;
    ret = lora_config(lora_dev, &config);
    if (ret < 0) {
        LOG_INF("LoRa config failed: %d\n", ret);
        return -1;
    }   
    return 0;
}

int lorasend(uint8_t *data_in)
{
    ret= lora_send(lora_dev,data_in,data_in[5]+6);
    if(ret <0){
        LOG_INF("datarec send fail\n");
        return -1;
    }
    times();
    return 1;
}
// use to receive datarec over lora 'datarec_out' struc
int lorarecv(uint8_t *datarec_in,uint32_t ms)
{
    ret = lora_recv(lora_dev,datarec_in,255,K_MSEC(ms),&rssi,&snr);
    if(ret<0){
        LOG_INF("datarec Received fail...\n");
        return 0;
    }
    printf("RSSI: %d dBm -> SNR: %d dBm \n",rssi,snr);
    times1(); 
    return 0;
}

// NeighborInfo_t neighbor_list[50]; 

int mesh_handle(usr_data_info_t *user_data)
{   
    //get device information for nvs for later use.
    get_devide(&my_device_info);

    //get Neighbor table for user.
    if (NTable.num_members ==0)
    {
        GetNeighborTable(&NTable);
    }
    ret = lora_recv(lora_dev,lora_data,255,K_MSEC(3000),&rssi,&snr);  
        if (ret < 0)
        {
            LOG_INF("NO Data Received...\n");
            
            // printf("0x%04x\n",user_data->usr_req_id);
            usr_req_handle(user_data);
            // printf("AAA\n");         
        }
        else{
            // times1();
            que_recv_config(lora_data,&data_recv,&msg_id);
            // Handle duplicate message :
            printf("%s\n",data_recv.message);
            if(previous_id==msg_id){
                // printf("%d\n",data_recv.mtypes);
                LOG_ERR(" > Duplicate message\n");
            }
            else
            {
                // Handle received data message 
                switch (data_recv.mtypes)
                {
                case private_message_type :
                    printf("-------------------------------------------------------------------\n\n");
                    LOG_INF("**Received Private Message**\n");
                    // printf("RSSI: %d dBm -> SNR: %d dBm \n",rssi,snr);
                    // check if the destination address is the received device
                    if (data_recv.destin_addr == my_device_info.ID)
                    {
                        for (int i = 0; i < NTable.num_members; i++)
                        {
                            // Find if the received data from known node
                            if (data_recv.source_addr == NTable.neighbors[i].ID)
                            {
                                
                                printf("\t >>: SNR (%d dBm) RSSI (%d dBm ) \n",snr,rssi);
                                LOG_INF("Data Received : %s :\n",data_recv.message);
                                printf("Source Adress : * 0x%04x * || Sender Name : %s \n",NTable.neighbors[i].ID,NTable.neighbors[i].Name);
                                state = true;// LOG_INF("");
                            }
                        }
                        if (!state){
                            LOG_INF("Data Received from Unkwon source : * %s * \t Source Address : 0x%04x || Name : * Unknown *\n",data_recv.message,data_recv.source_addr);
                        }
                            ack_data.source_addr= my_device_info.ID;
                            ack_data.destin_addr=data_recv.source_addr;
                            ack_data.lens_msg=0;
                            ack_data.mtypes=acknown_message_type;
                            que_send_config(&ack_data,send_resp_buf);
                            int ss;
                            for (int i = 0; i < 3; i++)
                            {
                                ss = lorasend(send_resp_buf);
                                times1();
                                k_sleep(K_MSEC(1000));  
                            }
                            if (ss>0)
                            {
                                printf("Response Send %d\n",send_resp_buf[0]);
                            }
                            else{
                                printf("Fail Response!");
                            }
                    }
                    else
                    {
                        //int s = lorasend(lora_data);
                        // Case destination address is not the receiving device
                        for (int i =0; i < NTable.num_members ; i++)
                        {
                            // the the known source addres message will relay
                            if (data_recv.source_addr == NTable.neighbors[i].ID)
                            {
                                // Broadcast previous received data (Relay)
                                int s = lorasend(lora_data);
                                if (s>0)
                                {
                                    times();
                                    LOG_INF("Data was Relay successful\n");
                                }
                                else
                                {
                                    LOG_ERR("Relay Fail\n");
                                }  
                            }
                        }
                    }
                    printf("-------------------------------------------------------------------\n\n");
                    break;
                // handle community message (Group chat message)
                case communi_message_type :
                    LOG_INF("----## COMMUNITY MESSAGE ## ----\n");
                    GetGroupInfo(data_recv.destin_addr,&GroupChatData,&k);
                    if (GroupChatData.id == 0)
                    {
                        // unknown group chat
                        for (int i = 0; i < NTable.num_members; i++)
                        {
                            if (data_recv.source_addr == NTable.neighbors[i].ID)
                            {
                                int s = lorasend (lora_data);
                                if(s>0)
                                {
                                    LOG_INF("\t > Data was Relay successful\n");
                                }
                                else
                                {
                                    LOG_INF("\t > Relay Fail\n");
                                }
                            } 
                        }                        
                        break;
                    }
                    for(int i=0; i<NTable.num_members ; i++)
                    {
                        if (data_recv.source_addr == GroupChatData.neighbors[i].ID)
                        {
                        
                            LOG_INF("Data Received : << %s >> \n",data_recv.message);
                            LOG_INF("\t Source Address << 0x%04x >> \n", data_recv.source_addr);
                            LOG_INF("\t SNR : << (%ddBm) RSSI : (%dBm)>> \n", snr,rssi);
                            // forward data received to other member
                            int s = lorasend (lora_data);
                            if (s>0)
                            {
                                LOG_INF(" Data was Relay successful\n");
                            }
                            else
                            {
                                LOG_INF(" Relay Fail\n");
                            }
                        break;
                        }
                    }
                    break;

                case joi_req_message_type :
                    LOG_INF("joint request message\n");
                    // check 
                    for (int i = 0; i < NTable.num_members; i++)
                    {
                        if (data_recv.source_addr != NTable.neighbors[i].ID)
                        {
                            LOG_ERR("Request from unknown Source please register to neighber node fist!\n");
                            break;
                        }  
                    }
                    GetGroupInfo(data_recv.destin_addr,&GroupChatData,&k);
                    if (GroupChatData.id == 0)
                    {
                        printf("Unknown Group\n");
                        break;
                    }
                    else if (GroupChatData.admin.ID != my_device_info.ID )
                    {
                        printf("Not admin >... No authority for make decision\n");
                        break;
                    }
                    // Request to user
                    LOG_INF(" Requesting to user ...\n");
                    while (recheck <60)
                    {
                        k_sleep(K_MSEC(500));
                        if (user_data->usr_req_id == user_reject)
                        {
                            LOG_ERR(" > User_Reject\n");
                            break;
                        }
                        else if (user_data->usr_req_id == user_approve)
                        {
                            LOG_INF("\t > User Aprove request");
                            if(GroupChatData.num_members >=20)
                            {
                                break;
                            }
                            SerializeGroupInfo(&GroupChatData,user_req_response_buffer,sizeof(user_req_response_buffer));
                            
                            resp_buffer.destin_addr=data_recv.source_addr;
                            resp_buffer.mtypes = joi_res_message_type;
                            resp_buffer.source_addr = my_device_info.ID;
                            memcpy(resp_buffer.message,user_req_response_buffer,sizeof(user_req_response_buffer));
                            que_send_config(&resp_buffer,send_resp_buf);
                            ret = lora_send(lora_dev,send_resp_buf,sizeof(send_resp_buf));
                            if (ret>0)
                            {
                                printf("\t > : Data Response Send!");
                            }
                            else
                            {
                                LOG_ERR("\t : Response Faill");
                            }
                            
                        }
                        
                        
                        recheck++;
                    }
                    LOG_INF(" Waiting For User Response ...\n");
                    break;
                case acknown_message_type :
                    printf("\n#############Received Ack message tyes\n");
                    int s = lorasend(lora_data);
                    if (s>0)
                    {
                        printf(" Info : data relay successfully.\n");
                    }
                    else
                    {
                        printf(" Info : data relay fail.\n");
                    }
                    printf("\n --------------------------------------\n");
                    break;
                default:
                    LOG_INF("%d Unknow Types\n",data_recv.mtypes);
                    break;
                }
            }
            previous_id = 0;
        }
    return 0;
}
rmv_group_mem_info_t dat_rmv ={0};
// uint8_t lo_send[255];
user_config_t td ={0};
que_packet_config send_data;

uint8_t nei_list[255];
//use for add node
NeighborInfo_t ndata;
GroupInfo_t GroupReqData_recv = {0};
crt_group_Info_t group_chatName;

crt_group_Info_t group_create_data = {0};

    uint8_t lo_send[256];  // Buffer for sending data over LoRa
    NeighborInfo_t ndata;//, deldata;  // Neighbor information structures
    GroupInfo_t GroupReqData_recv;  // Group request data structure
add_node_to_group_info_t add_node_data = {0};

/**
 * @brief Handle user requests.
 * 
 * @param user_data Pointer to the user data structure.
 * @return int 0 on success, non-zero on error.
 */
int usr_req_handle(usr_data_info_t *user_data) {

    switch (user_data->usr_req_id) {
        case user_send_req: 
        {

            // Process user request configuration
            int lens = user_rec_config(user_data->data, &td);
            if (lens < 0) {
                fprintf(stderr, "Failed to receive user configuration\n");
                return -1;
            }

            // Setup send_data structure with received configuration

            send_data.source_addr = my_device_info.ID;
            send_data.mtypes = td.mtypes;
            send_data.lens_msg = lens;
            send_data.destin_addr = td.destin;
            strncpy(send_data.message, td.msg, sizeof(send_data.message) - 1);
            send_data.message[sizeof(send_data.message) - 1] = '\0';  // Ensure null termination

            // Serialize send_data into lo_send buffer
            que_send_config(&send_data, lo_send);

        if (td.mtypes == private_message_type || td.mtypes == communi_message_type) { 
            for (uint8_t retry = 0; retry < 3; retry++) {
                ret = lora_send(lora_dev, lo_send, send_data.lens_msg);
                if (ret < 0) {
                    LOG_ERR(" >: Data Send to destination : 0x%04x : fail .\n", send_data.destin_addr);
                } else {   
                    LOG_INF(" Data Sent to destination : 0x%04x \n", send_data.destin_addr);
                    times1();
                    ret = lora_recv(lora_dev, lora_data, 255, K_MSEC(1000), &rssi, &snr);  
                    if (ret < 0) {
                        LOG_INF("NO acknowledgment message Received...\n");
                    } else {  
                        printf("*****************************************************************************************\n");
                        printf("RSSI: %d dBm -> SNR: %d dBm \n", rssi, snr);
                        que_recv_config(lora_data, &ack_data, &msg_id);

                        if (ack_data.mtypes == acknown_message_type) {
                            times();
                            printf("*****************************************************************************************\n\n");
                            LOG_INF("Destination :< 0x%04X >: Successful Received Data\n", ack_data.source_addr);
                            printf("\n*****************************************************************************************\n");
                            break;
                        }
                        if (msg_id == previous_id) {
                            LOG_ERR("Duplicate Message\n");
                            break;
                        }
                    }
                }
            }
        } else if (td.mtypes == joi_req_message_type) {
            for (int i = 0; i < 3; i++) {
                ret = lora_send(lora_dev, lo_send, send_data.lens_msg);
                if (ret < 0) {
                    LOG_ERR("Data Joint Request Fail\n");
                } else {
                    LOG_INF(" Data Sent >> Joint Request destination : 0x%04x \n", send_data.destin_addr);
                    LOG_INF("%s\n", send_data.message);
                    ret = lora_recv(lora_dev, lora_data, 255, K_MSEC(1000), &rssi, &snr);  
                    if (ret < 0) {
                        LOG_INF("NO Response Message Received...\n");
                    } else {
                        que_recv_config(lora_data, &ack_data, &msg_id);
                        if (ack_data.mtypes != joi_res_message_type) {
                            break;
                        } else {
                            LOG_INF("-------------------\n");
                            DeserializeGroupInfo(ack_data.message, &GroupReqData_recv);
                            printf("Group data: %04x\n\n", GroupReqData_recv.admin.ID);
                        }
                    }
                    k_sleep(K_MSEC(500));
                    LOG_INF("Retrying send data ... (%d/2)\n", retry);
                    if (i > 2) {
                        LOG_ERR("DATA SEND FAIL\n");
                        break;
                    }
                }
            }
        }
        break;
        }
        // successfully tested
        case user_req_sysReset:
            Sys_Reset();
            user_data->usr_req_id = 0;
            break;
        // successfully tested
        case user_check_deviceInfo:
            GetDeviceInfo();
            printf("\nDevice information retrieved successfully.\n");
            user_data->usr_req_id = 0;
            break;
        // successfully tested
        case user_check_neigbor_table_req:
            printf("Retrieving neighbor table...\n");
            Print_AllNeighbors();
            user_data->usr_req_id = 0;
            break;
        case user_delete_node_req:
            printf("--> : Deleting node from neighbor table...\n");
            // Call delete neighbor function
            user_data->usr_req_id = 0;
            break;
        // successfully tested
        case user_create_group_req:
            printf("--> : -----------------------------------------------------------\n");
            printf("--> : Creating group...\n");
            Uint8tTO_crtgroupInfo(user_data->data, &group_create_data);
            printf("--> : Group Name: %s\n", group_create_data.groupName);
            printf("--> : Neighbor Name: %s\n", group_create_data.Neighbors.Name);
            printf("--> : Neighbor ID: %02X\n", group_create_data.Neighbors.ID);
            CreateGroupChat(group_create_data.Neighbors, group_create_data.groupName);
            printf("--> : -----------------------------------------------------------\n");
            user_data->usr_req_id = 0;
            break;
        // successfully tested
        case user_check_group_req:
            printf("Retrieving all group information...\n");
            GetAllGroupInfo();
            user_data->usr_req_id = 0;
            break;
        // successfully tested
        case user_left_group_req:
            printf("Leaving group...\n");
            usr_to_neib(user_data->data, &deldata);
            DeleteGroupChat(deldata.ID);
            user_data->usr_req_id = 0;
            break;
        case user_response_req:
            printf("Processing user response request...\n");
            user_data->usr_req_id = 0;
            break;
        //sucessfully tested
        case user_addnNdeto_group_Chatreq:
            printf("Adding neighbor to group chat...\n");
            int a = Uint8t_addnodeINF_convert(user_data->data,&add_node_data);
            if (a>0)
            {
                Add_NeighborToGroupChat(add_node_data.group_chat_id,add_node_data.adding_node);
            }
            else{
                printf("--> : request process fail.\n");
            }
            user_data->usr_req_id = 0;
            break;
        //successfully tested
        case user_addNodeToTable_req:
            printf("Adding neighbor to table...\n");
            usr_to_neib(user_data->data, &ndata);
            Add_NeighborToTable(ndata);
            printf("Neighbor added to table successfully.\n");
            user_data->usr_req_id = 0;
            break;
        case user_remove_from_group_req :
            printf(" info : --------------------------------------------------\n");
            Uint8t_to_rmv_fgc(user_data->data,&dat_rmv);
            remove_node_fr_group(dat_rmv);
            break;
        default:
            printf("Unknown user request ID: %d\n", user_data->usr_req_id);
            user_data->usr_req_id = 0;
            break;
    }

    return 0;
}
uint8_t Scan_Data[300];
void Scan_Group_Chanel(void){
    ret = lora_recv(lora_dev,Scan_Data,255,K_MSEC(5000),NULL,NULL);
    if (ret >0)
    {
    }
}
void Broadcast_One_Channel(NeighborInfo_t GroupIdandName);
void Broadcasr_My_Info(void);
```

## src/mesh.h
```c
#ifndef MESH_H
#define MESH_H
#include <stdint.h>
#include <string.h>
#include "que_packet_handle.h"
#define user_resp_timeout 5000

#define add_node_to_goup_size_t 14  //size of buffer add node
/*
    ... Message Types Define ...
    * There are five different types of message use to communication in this network.
*/
enum types_message{
    private_message_type = 0x01,
    communi_message_type,
    acknown_message_type,
    joi_req_message_type,
    joi_res_message_type,
    broadcast_Info_type
};
int mesh_handle(usr_data_info_t *user_data);

/*Use For send data In lora 
    'Befor use this function'
    need to call '"lora_init()"';
*/

int lora_mesh_init(void);

int lorasend(uint8_t *data_in);

// use to receive data over lora 'data_out' struc
int lorarecv(uint8_t *data_in, uint32_t ms);


enum usr_req{
/*01*/  user_approve    =   0xA0,         //  user for joint response
/*02*/  user_reject,
/*03*/  user_delete_node_req,             //  Only authorize by admin
/*04*/  user_addNodeToTable_req,
/*05*/  user_addnNdeto_group_Chatreq,
/*06*/  user_check_NTable_req,
/*07*/  user_send_req, // there are private and comunity message for send request/*04*/
/*08*/  user_create_group_req,
/*09*/  user_check_group_req,
/*10*/  user_left_group_req,
/*11*/  user_response_req,
/*12*/  user_req_sysReset,
/*13*/  user_check_deviceInfo,
/*14*/  user_check_neigbor_table_req,
/*10*/  user_broadcast_req,
        user_update_dev_name_req,
        user_remove_from_group_req
};

int usr_req_handle(usr_data_info_t *user_data);
int joint_resp_handle(usr_data_info_t *user_data);


void Scan_Group_Chanel(void);
void Broadcast_All_GroupChannel(void);
void Broadcast_One_Channel(NeighborInfo_t GroupIdandName);
void Broadcasr_My_Info(void);

void ack_msg_handle(void);

#endif
```

## src/neighbor_table.h
```c
#ifndef NEIGHBOR_TABLE_H
#define NEIGHBOR_TABLE_H
#include <stdint.h>
#include <stdio.h>
#include <zephyr/kernel.h>
#include <zephyr/device.h>
#include <zephyr/drivers/flash.h>
#include <zephyr/storage/flash_map.h>
#include <zephyr/fs/nvs.h>
#include "que_packet_handle.h"
#include "neighbor_table.h"
#include <string.h>
#define device_Info_address 0xAAFF
#define MAX_GROUP_MEMBERS 20
#define MAX_GROUPS 10

// Define your neighbor information structure

//uint16_t neighborm[]={};
//uint16_t group_chat[]={};

/*
* @param id typically range 0xEA61 - 0xFFFF
* @param name is name of group chat
* @param num_members if number of members in group include adminn
*/

typedef struct neighbor {
    uint16_t ID;
    char Name[10]; 
}NeighborInfo_t;
typedef struct GroupChat 
{
    uint16_t id;
    char name[20];
    uint8_t num_members;
    NeighborInfo_t admin;
    NeighborInfo_t neighbors[10];
}GroupInfo_t;


typedef struct NeighborTable
{
    uint8_t num_members;
    NeighborInfo_t neighbors[50];
}NeighborTableInfo_t;


typedef struct Device_Information
{
    NeighborInfo_t Device;
    char Build_Date[50];
    char Developer_Info[100];

}DeviceInfo_t;

typedef struct create_group_chat
{
    NeighborInfo_t member;
    char group_chat_name[20];
}create_group_chat_info_t;


typedef struct crt_group_Info
{
    NeighborInfo_t Neighbors;
    char groupName[20];
}crt_group_Info_t;

typedef struct broadcast_info
{
    NeighborInfo_t Source;
    NeighborInfo_t Group_Channel;
}broadcast_info_t;

// @brief store add node to group info.
typedef struct add_node_to_group_inf
{
  uint16_t group_chat_id;
  NeighborInfo_t adding_node;
}add_node_to_group_info_t;

typedef struct rmv_group_mem
{
    uint16_t group_id;
    NeighborInfo_t remove_node;
}rmv_group_mem_info_t;


// NeighborTableInfo_t Table = {0};


int usr_to_neib(uint8_t *usr,NeighborInfo_t *neib);
// int respone_handle(uint8_t num_nei,NeighborInfo_t *nei_list);
int neib_to_user(NeighborInfo_t *nei,uint8_t *usr);

/*
@param neighbor_save is structure that store information of neighbor need to save.
*/
int save_neighbor(NeighborInfo_t *neighbor_save);
/*
@param group_del is structure that store information of group need to save.
*/
//int create_group(group_info *group_save);
/*
@param group_del is structure that store information of group need to delect.
*/
//int delet_group(group_info *group_del);
/*
@param delet_neighbor() is structure that store information of neighbor need to delect.
@param start_key : the start index to delete, it must be bigger or equal to 1;
@param end_key : is the end index in case the user want to delete only one index end_key="NULL"
@param id : is the id of the specific neighbor that user want to delete. In this case start_key and end_key must equal "NULL"

If use key please set id to '0';
*/
int delet_neighbor(NeighborInfo_t *neighbor);
/*
@param nvs_memo_init() use to intialize nvs memory parameter
*/
int nvs_memo_init(void);
/*
@param NEI is a array pointer for stor neibor data
@return number_neighbor The number of neighbor that saved. and 
return -1; for no neighbor in the community.
*/
int check_neighbor(NeighborInfo_t *NEI);

int nei_cnt();
/*
* it's return number of group count @cite
*@param ID is a group id that want to check memeber and admin
*/
int check_group(uint16_t group_id,NeighborInfo_t *nei_read);
int create_group(NeighborInfo_t *membor_data);
int group_check();
int read_group_id(uint16_t *id);
int delete_group(uint16_t gorup_id);

int add_node_to_group(uint16_t group_key, NeighborInfo_t new_member) ;

void store_group_members(uint8_t *data, int length, NeighborInfo_t *members, int max_members);




void Add_NeighborToTable(NeighborInfo_t neighbors);

void Remove_NeighborFromTable(uint16_t neighborID) ;


void Print_AllNeighbors() ;

void Remove_NeighborFromGroupChat(uint16_t group_id, uint16_t neighborID);
void Add_NeighborToGroupChat(uint16_t group_id, NeighborInfo_t neighbor) ;
void Add_NeighborToGroupChat(uint16_t group_id, NeighborInfo_t neighbor) ;
void GetGroupInfo(uint16_t group_id,GroupInfo_t * GroupData,uint16_t *keyID);
void CreateGroupChat(NeighborInfo_t neighbor,char *groupName);

/*
* @note this function use for getting Neighbor tabel from NVS-API
* @param *NeiTable  is a pointer for store data neighbor table
*/
void GetNeighborTable(NeighborTableInfo_t *Table);

void GetAllGroupInfo(void);
/*
* @note This function use for System Reset ( all data will clear!)
*/
void Sys_Reset(void);
/*
* @note : This function GetDeviceInfo 
*/
void GetDeviceInfo(void);

void SetDeviceInfo(DeviceInfo_t Device);
/*
*@param device is a struct for store device info (ID and Name)
*/
void get_devide(NeighborInfo_t *device);

/*
*@param *group 
*@param *buffer
*@param buffer_size
*@note for
*
*/
void SerializeGroupInfo(const GroupInfo_t *group, uint8_t *buffer, size_t buffer_size);
/*
* @param *buffer 
* @param *group 
* @note : This function
*/
void DeserializeGroupInfo(const uint8_t *buffer, GroupInfo_t *group);
// void UserRespHandle(usr_data_info_t *Usr_Data);

/*
* @note This function use to converter data type structure for crt_groupInfo_t to uint8t that use for create group message
* @param group_Info 
* @param *data
* @return
*/
void crt_groupInfoTOtoUint8t(crt_group_Info_t group_Info,uint8_t *data);
void Uint8tTO_crtgroupInfo(uint8_t *data,crt_group_Info_t *group_info);

void DeleteGroupChat(uint16_t group_id);

/* @brief user for convert add_node_to_group_info_t to uint8_t array pointer
* @param data input add_node_to_group_info_t struncture 
* @param the converted array pointer uint8_t
* @return 1 on success and -1 on fail
*/
int add_nodeINF_Uint8t_convert(add_node_to_group_info_t data,uint8_t *data_out);

/*  @brief reverse data from add add_nodeINF_Uint8t_convert function
*   @param data_in
*   @param data_out
*   @return 1 on success and -1 fail
*/
int Uint8t_addnodeINF_convert(uint8_t *data_in,add_node_to_group_info_t *data_out);

int remove_node_fr_group(rmv_group_mem_info_t data_rm);

int rmv_fgcTO_Uint8t(rmv_group_mem_info_t data,uint8_t * data_out);
int Uint8t_to_rmv_fgc(uint8_t *dataIn, rmv_group_mem_info_t *dataOut);
int Crt_non_AdminGroup(GroupInfo_t group_data);
#endif //NEIGHBOR_TABLE_H
```

## src/que_packet_handle.c
```c
#include <stdio.h>
#include <stdint.h>
#include <string.h>
#include <stdlib.h>
#include "que_packet_handle.h"
#include "neighbor_table.h"

#include "mesh.h"
NeighborInfo_t my_lora_devInfo ={0};

uint16_t generate_random_uint16(void) {
    // Combine two calls to rand() to get a more uniformly distributed 16-bit random number
    return (uint16_t)((rand() << 15) | (rand() & 0x7FFF));
}
/**
 * @brief Prepare the packet for sending based on the input configuration.
 * 
 * @param data_in Pointer to the input packet configuration structure.
 * @param data_out Pointer to the output byte array where the packet will be stored.
 */
void que_send_config(que_packet_config *data_in, uint8_t *data_out) {
    // Check for NULL pointers
    if (data_in == NULL || data_out == NULL) {
        fprintf(stderr, "Error: NULL pointer passed to que_send_config.\n");
        return;
    }

    // Check message length to prevent buffer overflow
    if (data_in->lens_msg > MAXD - 8) {
        fprintf(stderr, "Error: Message length exceeds buffer size.\n");
        return;
    }

    get_devide(&my_lora_devInfo);
    printf("** 0x%04x ** %s\n", my_lora_devInfo.ID, my_lora_devInfo.Name);

    uint16_t message_id = generate_random_uint16(); // Generate a random message ID

    // Copy mtypes directly
    data_out[0] = data_in->mtypes; // Message types

    // Copy MYID (assuming MYID is defined elsewhere as a uint16_t)
    data_out[1] = (uint8_t)(my_lora_devInfo.ID >> 8);
    data_out[2] = (uint8_t)my_lora_devInfo.ID;

    // Copy destin_addr (destination address)
    data_out[3] = (uint8_t)((data_in->destin_addr & 0xff00) >> 8);
    data_out[4] = (uint8_t)(data_in->destin_addr & 0x00ff);

    // Copy lens_msg (length of the message)
    data_out[5] = data_in->lens_msg;

    // Copy message_id
    data_out[6] = (uint8_t)(message_id >> 8);
    data_out[7] = (uint8_t)(message_id & 0x00ff);

    // Copy the message string
    for (int i = 0; i < data_in->lens_msg; i++) {
        data_out[8 + i] = data_in->message[i];
    }

    // Ensure null termination in the output (optional)
    // This is only necessary if data_out needs to be a null-terminated string.
    // Adjust the index if you want to include the null terminator after the message.
    data_out[8 + data_in->lens_msg] = '\0';
}
/**
 * @brief Receive and parse the packet configuration.
 * 
 * @param data_in Pointer to the input byte array containing the received packet.
 * @param data_out Pointer to the output packet configuration structure.
 * @param msg_id Pointer to store the extracted message ID.
 */
void que_recv_config(uint8_t *data_in, que_packet_config *data_out, uint16_t *msg_id) {
    // Check for NULL pointers
    if (data_in == NULL || data_out == NULL || msg_id == NULL) {
        fprintf(stderr, "Error: NULL pointer passed to que_recv_config.\n");
        return;
    }

    // Copy mtypes directly
    data_out->mtypes = data_in[0];

    // Copy source_addr
    data_out->source_addr = ((uint16_t)data_in[1] << 8) | (uint16_t)data_in[2];

    // Copy destin_addr
    data_out->destin_addr = ((uint16_t)data_in[3] << 8) | (uint16_t)data_in[4];

    // Copy lens_msg (length of the message)
    data_out->lens_msg = data_in[5];

    // Copy message_id
    *msg_id = ((uint16_t)data_in[6] << 8) | (uint16_t)data_in[7];

    // Ensure that the message length does not exceed the buffer size
    if (data_out->lens_msg > (MAXD - 8)) {
        fprintf(stderr, "Warning: Message length exceeds buffer size, truncating message.\n");
        data_out->lens_msg = MAXD - 8; // Adjust to prevent overflow
    }

    // Copy the message string
    for (int i = 0; i < data_out->lens_msg; i++) {
        data_out->message[i] = data_in[8 + i];
    }

    // Null-terminate the message string
    data_out->message[data_out->lens_msg] = '\0';
}


/**
 * @brief Convert NeighborInfo_t structure to a user byte array.
 * 
 * @param nei Pointer to the NeighborInfo_t structure.
 * @param usr Pointer to the output byte array where the neighbor info will be stored.
 * @return int 0 on success, -1 on error.
 */
int neib_to_user(NeighborInfo_t *nei, uint8_t *usr) {
    // Check for NULL pointers
    if (nei == NULL || usr == NULL) {
        fprintf(stderr, "Error: NULL pointer passed to neib_to_user.\n");
        return -1; // Return an error code if input pointers are NULL
    }

    // Assign the ID to the first two bytes of usr
    usr[0] = (uint8_t)(nei->ID >> 8);
    usr[1] = (uint8_t)(nei->ID & 0xFF);

    // Copy the Name field to the usr array
    for (int i = 0; i < 10; i++) {
        usr[i + 2] = (uint8_t)nei->Name[i];
    }

    // Ensure the Name field is null-terminated if it's meant to be a string
    if (strlen(nei->Name) < 10) {
        usr[strlen(nei->Name) + 2] = '\0';
    }

    return 0;
}


/**
 * @brief Prepare the user configuration packet for sending.
 * 
 * @param data Pointer to the input user configuration structure.
 * @param data_out Pointer to the output byte array where the packet will be stored.
 * @return int 0 on success, -1 on error.
 */
int usr_send_config(user_config_t *data, uint8_t *data_out) {
    // Check for NULL pointers
    if (data == NULL || data_out == NULL) {
        fprintf(stderr, "Error: NULL pointer passed to usr_send_config.\n");
        return -1; // Return an error code if input pointers are NULL
    }

    // Copy message type
    data_out[0] = data->mtypes; // Message types

    // Copy destination address
    data_out[1] = (uint8_t)((data->destin & 0xff00) >> 8);
    data_out[2] = (uint8_t)(data->destin & 0x00ff);

    // Calculate the message length
    uint8_t lens = (uint8_t)strlen(data->msg);
    if (lens > 247) {
        lens = 247; // Ensure the message length does not exceed 247
    }
    data_out[3] = lens;

    // Copy the message string
    for (int i = 0; i < lens; i++) {
        data_out[4 + i] = data->msg[i];
    }

    // Ensure null termination in the output (optional)
    data_out[4 + lens] = '\0';

    return 0; // Return 0 on success
}

int user_rec_config(uint8_t *usr,user_config_t *rec)
{
  rec->mtypes = usr[0];
  rec->destin = (((uint16_t)usr[1])<<8)+((uint16_t)usr[2]);
  char msgs[247];
  for (int i = 0; i <usr[3] ; i++)
    {
        msgs[i]=usr[i+4];
    }
    strncpy(rec->msg,msgs,usr[3]);
  return usr[3];
}

int u16to8(uint16_t *din, uint8_t *dout,int lens)
{
  for (int i = 0; i < lens; i++)
  {
    dout[i] = (uint8_t)((din[i] & 0xff00)>>8);
    dout[2*i+1]= (uint8_t)(din[i] & 0x00ff);
    if (lens>=127)
    {
      printf("<buffer full>\n");
      break;
    }
    
  }
  return 1;
}
void CreateGroupChatInfo_Uint8t(create_group_chat_info_t data,uint8_t *dataout){
  for (int i = 0; i < 20; i++)
  {
    dataout[i] = data.group_chat_name[i];
  }
  for (int i = 0; i < 10; i++)
  {
    dataout[i+20] = data.member.Name[i];
  }

    dataout[30]=(uint8_t)((data.member.ID & 0xff00) >> 8); 

    dataout[31]=(uint8_t)(data.member.ID & 0x00ff);
}

void Uint8tTo_CreateGroupChatInfo(uint8_t *datain,create_group_chat_info_t *data){
  for (int i = 0; i < 20; i++)
  {
    data->group_chat_name[i]= datain[i];
  }
  for (int i = 0; i < 10; i++)
  {
    data->member.Name[i] = datain[i+20];
  }
  data->member.ID = (((uint16_t)datain[30]) << 8) + (uint16_t)datain[31];
  return;
}
```

## src/que_packet_handle.h
```c
#ifndef QUE_PACKET_HANDLE_H
#define QUE_PACKET_HANDLE_H
#include<stdint.h>
#include "neighbor_table.h"
#define MAXD 0xff

typedef struct USER_DATA
{
  uint8_t usr_req_id ;
  uint8_t data[MAXD-1];
}usr_data_info_t;
typedef struct user_cofing{
  uint8_t mtypes;
  uint16_t destin; //destination address
  char msg[247];
}user_config_t;

typedef struct que_pack {
  uint8_t mtypes;       //  1 byte message types
  uint16_t source_addr; //  2 byte source address
  uint16_t destin_addr; //  2 byte destination address
  uint8_t lens_msg;     //  1 byte message lengths
  char message[MAXD]; // Assuming message is null-terminated
}que_packet_config;
void que_send_config(que_packet_config *data_in, uint8_t *data_out);
void que_recv_config( uint8_t *data_in, que_packet_config *data_out,uint16_t *msg_id);
uint16_t generate_random_uint16(void);

/*
*@param num_nei stor the number of neighbor in the community
*@param nei_list pointer to the neighbor list data array type uint8_t 
*@return 
* 1 for successful rsponse
* -1 for fail to respone
*/

// int respone_handle(uint8_t num_nei,NeighborInfo_t *nei_list);
// int neib_to_user(NeighborInfo_t *nei,uint8_t *usr);
// int usr_to_neib(uint8_t *usr,NeighborInfo_t *neib);
int usr_send_config(user_config_t *data,uint8_t *data_out);
int user_rec_config(uint8_t *usr,user_config_t *rec);
int u16to8(uint16_t *din, uint8_t *dout,int lens);


// void CreateGroupChatInfo_Uint8t(create_group_chat_info_t data,uint8_t *dataout);
// void Uint8tTo_CreateGroupChatInfo(uint8_t *datain,create_group_chat_info_t *data);
#endif /* QUE_PACKET_HANDLE_H */  
```

## src/read.c
```c
#include <zephyr/drivers/gpio.h>
#include <stdio.h>
#include <zephyr/kernel.h>

#define GPIO_DEVICE_NAME_A "GPIOA"
#define GPIO_DEVICE_NAME_B "GPIOB"
#define GPIO_PIN_A0 0 // Pin 5 on GPIOA
#define GPIO_PIN_A1 1 // Pin 13 on GPIOB
#define LED_PIN1 9 // Pin 12 on GPIOB
#define LED_PIN2 11
#define LED_PIN3 15

int times()
{
    const struct device *gpio_dev_a;
    const struct device *gpio_dev_b;
    //gpio_port_value_t pin_value;
    int ret;

    gpio_dev_a = DEVICE_DT_GET_OR_NULL(DT_NODELABEL(gpioa));
    gpio_dev_b = DEVICE_DT_GET_OR_NULL(DT_NODELABEL(gpiob));

    if (!gpio_dev_a || !device_is_ready(gpio_dev_a)) {
        printf("GPIO device A not found or not ready\n");
        return -ENODEV;
    }

    if (!gpio_dev_b || !device_is_ready(gpio_dev_b)) {
        printf("GPIO device B not found or not ready\n");
        return -ENODEV;
    }

    // Configure the GPIO pin for the button A as an input
    ret = gpio_pin_configure(gpio_dev_a, GPIO_PIN_A0, GPIO_INPUT | GPIO_PULL_UP);
    if (ret < 0) {
        printf("Error configuring GPIO pin %d: %d\n", GPIO_PIN_A1, ret);
        return ret;
    }

    // Configure the GPIO pin for the button B as an input
    ret = gpio_pin_configure(gpio_dev_b, GPIO_PIN_A1, GPIO_INPUT | GPIO_PULL_UP);
    if (ret < 0) {
        printf("Error configuring GPIO pin %d: %d\n", GPIO_PIN_A1, ret);
        return ret;
    }

    // Configure the GPIO pin for the LED as an output
    ret = gpio_pin_configure(gpio_dev_b, LED_PIN1, GPIO_OUTPUT);
    if (ret < 0) {
        printf("Error configuring GPIO pin %d: %d\n", LED_PIN1, ret);
        return ret;
    }
    ret = gpio_pin_configure(gpio_dev_b, LED_PIN2, GPIO_OUTPUT);
    if (ret < 0) {
        printf("Error configuring GPIO pin %d: %d\n", LED_PIN2, ret);
        return ret;
    }
        ret = gpio_pin_configure(gpio_dev_b, LED_PIN3, GPIO_OUTPUT);
    if (ret < 0) {
        printf("Error configuring GPIO pin %d: %d\n", LED_PIN3, ret);
        return ret;
    }
    int x;
    for(int i =0; i<6;i++) {



		x = gpio_pin_get(gpio_dev_a,GPIO_PIN_A0);
		if (ret < 0) {
			// printk("Error reading GPIOA pin 5\n");
			return 0;
		}
		// printk("GPIOA pin 5 value: %d\n", x);


        // Read the value of the GPIO pin for the button B
        ret = gpio_pin_get(gpio_dev_b, GPIO_PIN_A1);
        if (ret < 0) {
            printf("Error reading GPIO pin %d: %d\n", GPIO_PIN_A0, ret);
            return ret;
        }

            // At least one button is pressed, turn the LED on
			if (x ==0)
			{
                gpio_pin_set(gpio_dev_b, LED_PIN3, 1);
                // printf("LED state: %d ",gpio_pin_get(gpio_dev_b,LED_PIN1));
			}
            else{
                gpio_pin_set(gpio_dev_b, LED_PIN3, 0);
            }

				
            
        k_sleep(K_MSEC(20));
		// gpio_pin_set(gpio_dev_b, LED_PIN1, 1);
        // gpio_pin_set(gpio_dev_b, LED_PIN2, 1);
        gpio_pin_set(gpio_dev_b, LED_PIN3, 1);
        // printf("LED state: %d ",gpio_pin_get(gpio_dev_b,LED_PIN1));
        
        k_sleep(K_MSEC(20));
		// gpio_pin_set(gpio_dev_b, LED_PIN1, 0);
        // gpio_pin_set(gpio_dev_b, LED_PIN2, 0);
        gpio_pin_set(gpio_dev_b, LED_PIN3, 0);
        // printf("LED state: %d\n ",gpio_pn_get(gpio_dev_b,LED_PIN1));
         
    }

    return 0;
}


int times1()
{
    const struct device *gpio_dev_a;
    const struct device *gpio_dev_b;
    //gpio_port_value_t pin_value;
    int ret;

    gpio_dev_a = DEVICE_DT_GET_OR_NULL(DT_NODELABEL(gpioa));
    gpio_dev_b = DEVICE_DT_GET_OR_NULL(DT_NODELABEL(gpiob));

    if (!gpio_dev_a || !device_is_ready(gpio_dev_a)) {
        printf("GPIO device A not found or not ready\n");
        return -ENODEV;
    }

    if (!gpio_dev_b || !device_is_ready(gpio_dev_b)) {
        printf("GPIO device B not found or not ready\n");
        return -ENODEV;
    }

    // Configure the GPIO pin for the button A as an input
    ret = gpio_pin_configure(gpio_dev_a, GPIO_PIN_A0, GPIO_INPUT | GPIO_PULL_UP);
    if (ret < 0) {
        printf("Error configuring GPIO pin %d: %d\n", GPIO_PIN_A1, ret);
        return ret;
    }

    // Configure the GPIO pin for the button B as an input
    ret = gpio_pin_configure(gpio_dev_b, GPIO_PIN_A1, GPIO_INPUT | GPIO_PULL_UP);
    if (ret < 0) {
        printf("Error configuring GPIO pin %d: %d\n", GPIO_PIN_A1, ret);
        return ret;
    }

    // Configure the GPIO pin for the LED as an output
    ret = gpio_pin_configure(gpio_dev_b, LED_PIN1, GPIO_OUTPUT);
    if (ret < 0) {
        printf("Error configuring GPIO pin %d: %d\n", LED_PIN1, ret);
        return ret;
    }
    ret = gpio_pin_configure(gpio_dev_b, LED_PIN2, GPIO_OUTPUT);
    if (ret < 0) {
        printf("Error configuring GPIO pin %d: %d\n", LED_PIN2, ret);
        return ret;
    }
        ret = gpio_pin_configure(gpio_dev_b, LED_PIN3, GPIO_OUTPUT);
    if (ret < 0) {
        printf("Error configuring GPIO pin %d: %d\n", LED_PIN3, ret);
        return ret;
    }
    int x;
    for(int i =0; i<6;i++) {



		x = gpio_pin_get(gpio_dev_a,GPIO_PIN_A0);
		if (ret < 0) {
			// printk("Error reading GPIOA pin 5\n");
			return 0;
		}
		// printk("GPIOA pin 5 value: %d\n", x);


        // Read the value of the GPIO pin for the button B
        ret = gpio_pin_get(gpio_dev_b, GPIO_PIN_A1);
        if (ret < 0) {
            printf("Error reading GPIO pin %d: %d\n", GPIO_PIN_A0, ret);
            return ret;
        }

            // At least one button is pressed, turn the LED on
			if (x ==0)
			{
                gpio_pin_set(gpio_dev_b, LED_PIN3, 1);
                // printf("LED state: %d ",gpio_pin_get(gpio_dev_b,LED_PIN1));
			}
            else{
                gpio_pin_set(gpio_dev_b, LED_PIN3, 0);
            }

				
            
        k_sleep(K_MSEC(20));
		// gpio_pin_set(gpio_dev_b, LED_PIN1, 1);
        gpio_pin_set(gpio_dev_b, LED_PIN2, 1);
        // gpio_pin_set(gpio_dev_b, LED_PIN3, 1);
        // printf("LED state: %d ",gpio_pin_get(gpio_dev_b,LED_PIN1));
        
        k_sleep(K_MSEC(20));
		// gpio_pin_set(gpio_dev_b, LED_PIN1, 0);
        gpio_pin_set(gpio_dev_b, LED_PIN2, 0);
        // gpio_pin_set(gpio_dev_b, LED_PIN3, 0);
        // printf("LED state: %d\n ",gpio_pn_get(gpio_dev_b,LED_PIN1));
         
    }

    return 0;
}
```

## src/read.h
```c
#ifndef READ_H
#define READ_H

int times(void);
int times1(void);
#endif
```
